AUTOSAR XML
package /Ecus
  ecu instance SensorEcu: ecuc=config/ecuc/SensorEcu.ecuc.json
    can communication connector SensorEcu_Can0: cluster=/Network/Can500k
      frame port FP_VehicleSpeed: communication-direction=OUT, frame=/Network/Frames/Frame_VehicleSpeed
  ecu instance LightEcu: ecuc=config/ecuc/LightEcu.ecuc.json
    can communication connector LightEcu_Can0: cluster=/Network/Can500k
      4 x frame port:
        FP_VehicleSpeed: communication-direction=IN, frame=/Network/Frames/Frame_VehicleSpeed
        FP_AmbientLight: communication-direction=IN, frame=/Network/Frames/Frame_AmbientLight
        FP_EcuModeReq: communication-direction=IN, frame=/Network/Frames/Frame_EcuModeReq
        FP_LightStatus: communication-direction=OUT, frame=/Network/Frames/Frame_LightStatus
  ecu instance RestBus: generate=false
    can communication connector RestBus_Can0: cluster=/Network/Can500k
      frame port FP_AmbientLight: communication-direction=OUT, frame=/Network/Frames/Frame_AmbientLight
      frame port FP_EcuModeReq: communication-direction=OUT, frame=/Network/Frames/Frame_EcuModeReq
package /Network
  can cluster Can500k: baudrate=500000, can-fd=false
package /Network/Signals
  5 x i signal:
    VehicleSpeed: length=16, type=uint16, init-value=0
    AmbientLight: length=8, type=uint8, init-value=255
    EcuModeRequest: length=8, type=uint8, init-value=0
    HeadlightStatus: length=8, type=uint8, init-value=0
    OdometerDistance: length=32, type=uint32, init-value=0
package /Network/Pdus
  pdu Pdu_VehicleSpeed: length=2, i-signal-to-i-pdu-mapping{i-signal=/Network/Signals/VehicleSpeed, packing-byte-order=little-endian, start-position=0, transfer-property=PENDING}, transmission-mode=CYCLIC, period=0.020, offset=0
  pdu Pdu_AmbientLight: length=1, i-signal-to-i-pdu-mapping{i-signal=/Network/Signals/AmbientLight, packing-byte-order=little-endian, start-position=0, transfer-property=PENDING}, transmission-mode=CYCLIC, period=0.1, offset=0
  pdu Pdu_EcuModeReq: length=1, i-signal-to-i-pdu-mapping{i-signal=/Network/Signals/EcuModeRequest, packing-byte-order=little-endian, start-position=0, transfer-property=PENDING}, transmission-mode=CYCLIC, period=0.1, offset=0
  pdu Pdu_LightStatus: length=6, transmission-mode=CYCLIC, period=0.1, offset=0
    i-signal-to-pdu-mappings:
      i-signal=/Network/Signals/HeadlightStatus, packing-byte-order=little-endian, start-position=0, transfer-property=PENDING
      i-signal=/Network/Signals/OdometerDistance, packing-byte-order=little-endian, start-position=16, transfer-property=PENDING
package /Network/Frames
  4 x can frame, all with can-addressing-mode=STANDARD:
    Frame_VehicleSpeed: frame-length=2, pdu=/Network/Pdus/Pdu_VehicleSpeed, identifier=0x101
    Frame_LightStatus: frame-length=6, pdu=/Network/Pdus/Pdu_LightStatus, identifier=0x201
    Frame_AmbientLight: frame-length=1, pdu=/Network/Pdus/Pdu_AmbientLight, identifier=0x301
    Frame_EcuModeReq: frame-length=1, pdu=/Network/Pdus/Pdu_EcuModeReq, identifier=0x3F0
package /MiniSystem
  system MiniAutosarSystem: mapping={swc-to-ecu-mappings=[{component=SpeedSensor, ecu=/Ecus/SensorEcu}, {component=BswM, ecu=/Ecus/SensorEcu}, {component=LightControl, ecu=/Ecus/LightEcu}, {component=LightActuator, ecu=/Ecus/LightEcu}, {component=Odometer, ecu=/Ecus/LightEcu}, {component=BswM, ecu=/Ecus/LightEcu}], sender-receiver-to-signal-mappings=[{component=SpeedSensor, port=P_VehicleSpeed, data-element=VehicleSpeed, i-signal=/Network/Signals/VehicleSpeed}, {component=LightControl, port=R_VehicleSpeed, data-element=VehicleSpeed, i-signal=/Network/Signals/VehicleSpeed}, {component=LightControl, port=R_AmbientLight, data-element=AmbientLight, i-signal=/Network/Signals/AmbientLight}, {component=LightActuator, port=P_HeadlightStatus, data-element=HeadlightStatus, i-signal=/Network/Signals/HeadlightStatus}, {component=LightActuator, port=P_OdometerDistance, data-element=Distance, i-signal=/Network/Signals/OdometerDistance}]}
    root-software-compositions:
      root sw composition prototype RootComposition
        5 x component:
          SpeedSensor: type=/ComponentTypes/SpeedSensorSWC
          LightControl: type=/ComponentTypes/LightControlSWC
          LightActuator: type=/ComponentTypes/LightActuatorSWC
          Odometer: type=/ComponentTypes/OdometerSWC
          BswM: type=/ComponentTypes/BswM_Service
        connect {component=LightControl, port=P_HeadlightCmd} -> {component=LightActuator, port=R_HeadlightCmd}
        connect {component=Odometer, port=P_Odometer} -> {component=LightControl, port=R_Odometer}
        connect {component=Odometer, port=P_Odometer} -> {component=LightActuator, port=R_Odometer}
        connect {component=BswM, port=P_EcuMode} -> {component=LightControl, port=R_EcuMode}
        connect {component=SpeedSensor, port=P_VehicleSpeed} -> {component=LightControl, port=R_VehicleSpeed}
